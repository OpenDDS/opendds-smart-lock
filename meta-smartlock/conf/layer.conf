## meta-smartlock/conf/layer.conf
```bitbake
# We have a conf and classes directory, add to BBPATH
BBPATH .= ":${LAYERDIR}"

# We have recipes-* directories, add to BBFILES
BBFILES += "${LAYERDIR}/recipes-*/*/*.bb \
            ${LAYERDIR}/recipes-*/*/*.bbappend"

BBFILE_COLLECTIONS += "meta-smartlock"
BBFILE_PATTERN_meta-smartlock = "^${LAYERDIR}/"
BBFILE_PRIORITY_meta-smartlock = "6"

LAYERDEPENDS_meta-smartlock = "core"
LAYERSERIES_COMPAT_meta-smartlock = "kirkstone"
```
